## apps/tuya_t5_pocket/tuya_t5_pocket_buddy/Kconfig
```kconfig
menu "Tuya T5 Pocket Buddy"

config DISABLE_BUDDY_CJK_FONT
    bool "Disable CJK font (faster compile)"
    default n
    help
        Disables the large CJK bitmap font to speed up compilation
        during development. Turn this OFF for production builds.

endmenu
```

## boards/JIELI/AC7916A/Kconfig
```kconfig
config BOARD_CONFIG
    bool
    default y

config CHIP_AC7916A
    bool
    default y

config JIELI_UART_LOG_PORT
    int "AC7916A UART log port"
    default 0
    range 0 5

config JIELI_UART_LOG_BAUDRATE
    int "AC7916A UART log baudrate"
    default 115200
    range 1200 4000000
```

## boards/JIELI/Kconfig
```kconfig
config PLATFORM_CHOICE
    string
    default "JIELI"

config CHIP_CHOICE
    string
    default "AC7916A"

config BOARD_CHOICE
    string
    default "AC7916A"

choice
    prompt "Choice a board"

    config BOARD_CHOICE_AC7916A
        bool "AC7916A"
        if (BOARD_CHOICE_AC7916A)
            rsource "./AC7916A/Kconfig"
        endif

endchoice
```

## examples/multimedia/sanotts_serial/Kconfig
```kconfig
menu "sanoTTS serial configuration"

    config SNT_UART_NUM
        int "UART port number for SNT protocol"
        default 0
        range 0 2
        help
            UART port to use for communicating with host PC (0, 1, or 2).
            Default is 0 (USB console UART on T5AI-Core).

    config SNT_UART_BAUDRATE
        int "UART baudrate"
        default 115200
        help
            Baudrate for SNT protocol communication.

    config SNT_AUDIO_OUTPUT_RATE
        int "Audio output sample rate (Hz)"
        default 16000
        help
            Sample rate sent to the onboard speaker hardware.

    config SNT_RING_BUFFER_SIZE
        int "Audio PCM ring buffer size (bytes)"
        default 32768
        help
            Size of PCM16 ring buffer in PSRAM (32768 bytes = 1.024s at 16kHz mono).

    config SNT_DIAGNOSTICS
        bool "Enable diagnostics and PCM capture"
        default n
        help
            Enable raw PCM base64 capture and diagnostics for GOLDEN verification.

endmenu
```

## platform/JIELI/Kconfig
```kconfig
menu "configure Jieli wl82"

config JIELI_MINIMAL_HELLO
    bool "Jieli minimal UART hello image"
    default y
    help
        Keep the vendor bridge on the minimal UART image. Disable this for
        applications that need the complete TuyaOpen component graph.

config PLATFORM_JIELI
    bool
    default y

config OPERATING_SYSTEM
    int
    default 98
    ---help---
        98      /* RTOS */

config LITTLE_END
    int
    default 1

config ENABLE_UART
    bool "ENABLE_UART --- use UART output"
    default y

config LOG_UART_PORT
    int "Jieli log UART port"
    default 0
    range 0 5

config LOG_UART_BAUDRATE
    int "Jieli log UART baudrate"
    default 115200
    range 1200 4000000

config ENABLE_WIFI
    bool "ENABLE_WIFI --- use Wi-Fi"
    default n

config ENABLE_BLUETOOTH
    bool "ENABLE_BLUETOOTH --- use Bluetooth"
    default n

endmenu
```

## src/luanode/Kconfig
```kconfig
menuconfig ENABLE_LUANODE
    bool "Enable Lua node"
    default n
    help
        Enable Lua interpreter component for TuyaOpen.

if ENABLE_LUANODE

config LUANODE_HEAP_SIZE
    int "Lua heap size (KB)"
    default 64
    range 16 1024
    help
        Heap size reserved for Lua runtime in kilobytes.

config LUANODE_STACK_SIZE
    int "Lua task stack size (bytes)"
    default 4096
    range 2048 32768
    help
        Stack size used by Lua execution tasks.

config LUANODE_MAX_SCRIPT_SIZE
    int "Lua script size limit (bytes)"
    default 65536
    range 256 1048576
    help
        Maximum script size accepted by Lua runtime APIs.

config LUANODE_ENABLE_STD_LIBS
    bool "Enable Lua standard libraries"
    default y
    help
        Enable Lua standard libraries. Disable this for restricted products.

config LUANODE_ENABLE_CLI
    bool "Enable Lua CLI commands"
    default n
    depends on ENABLE_SERIAL_CLI_CMD
    help
        Enable serial CLI commands to run Lua scripts for debugging.

config LUANODE_ENABLE_TUYA_LIBS
    bool "Enable Tuya Lua libraries"
    default y
    help
        Enable Tuya helper libraries exposed to Lua scripts.

endif # ENABLE_LUANODE
```

## src/tuya_cloud_service/Kconfig
```kconfig
menu "configure tuya cloud service"

    config TUYA_SECURITY_LEVEL
        int
        range 0 3
        default 1

        ---help---
                0       /* security level 0,Applies to: Resource-constrained devices;Feature: Can only access Tuya Cloud */
                1       /* security level 1,Applies to: Resource-constrained devices;Feature: One-way authentication */
                2       /* security level 2,Applies to: Resource-rich equipment;Feature: Two-way authentication */
                3       /* security level 3,Applies to: Resource-rich equipment;Feature: Two-way authentication,Devices use security chips to protect sensitive information */


    menuconfig  ENABLE_BT_SERVICE
        bool "ENABLE_BT_SERVICE: enable tuya bt iot function"
        default n

        if (ENABLE_BT_SERVICE)
            config ENABLE_BT_NETCFG
                bool "ENABLE_BT_NETCFG: enable tuya Bluetooth netconfig"
                default y

            config ENABLE_BT_CTRL
                bool "ENABLE_BT_CTRL: enable tuya Bluetooth control"
                default y

            config BT_ADV_INTERVAL_MIN
                int "BT_ADV_INTERVAL_MIN: tuya Bluetooth min adv interval,bet:ms"
                range 10 2000
                default 30

            config BT_ADV_INTERVAL_MAX
                int "BT_ADV_INTERVAL_MAX: tuya Bluetooth max adv interval,bet:ms"
                range 10 2000
                default 60
            
            config BT_REMOTE_CTRL_SCAN_INTERVAL
                int "BT_REMOTE_CTRL_SCAN_INTERVAL: tuya Bluetooth remote control scan interval,bet:ms"
                range 10 2000
                default 30

            config BT_REMOTE_CTRL_SCAN_WINDOWS
                int "BT_REMOTE_CTRL_SCAN_WINDOWS: tuya Bluetooth remote control scan windows,bet:ms"
                range 10 2000
                default 10

            menuconfig ENABLE_NIMBLE
                bool "ENABLE_NIMBLE: enable nimble stack instead of ble stack in board"
                default y
                if (ENABLE_NIMBLE) 
                    config TUYA_HS_BLE_HOST_TASK_PRIORITY
                    int "TUYA_HS_BLE_HOST_TASK_PRIORITY config bt host task proi"
                    range 0 100
                    default 9
                    config TUYA_HS_BLE_HOST_STACK_SIZE
                    int "TUYA_HS_BLE_HOST_STACK_SIZE config bt host task size"
                    range 0 10000
                    default 5120

                    config ENABLE_CLAUDE_DESKTOP_BUDDY_BLE
                    bool "ENABLE_CLAUDE_DESKTOP_BUDDY_BLE: co-register Nordic UART Service for Claude Desktop Buddy"
                    default n
                    ---help---
                        When enabled, the Tuya BLE peripheral GATT database is extended
                        with a secondary primary service exposing the Nordic UART Service
                        (NUS) used by the Claude Desktop Buddy protocol. The Tuya provisioning
                        service continues to work in parallel. The application can then
                        advertise as "Claude_XXXX" and use the NUS characteristics for
                        JSON-over-BLE traffic without tearing down the Tuya BLE stack.
                endif
        endif
endmenu
    
```
