## src/peripherals/camera/Kconfig
```kconfig
config ENABLE_CAMERA
    bool "enable camera"
    default n

if (ENABLE_CAMERA)
    config CAMERA_NAME
        string "the name of camera"
        default "camera"
    config ENABLE_DVP_V1
        bool "DVP v1 drivers (TKL exposes the pull API)"
        default n
        help
            Builds the JIELI DVP v1 driver set: each camera module is a
            self-contained TDD that pulls frames through tkl_dvp_get_frame()
            instead of the callback API. Turn it on only when the platform
            header defines TKL_DVP_HAS_PULL_API.
endif
```
